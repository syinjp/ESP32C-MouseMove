## main/Kconfig.projbuild
```kconfig
menu "MouseMove Configuration"

    config MOUSE_DEVICE_NAME
        string "Bluetooth device name"
        default "ESP32-C3 MouseMove"
        help
            Name shown in the host's Bluetooth device list.

    config MOUSE_MOVE_INTERVAL_SEC
        int "Movement interval (seconds)"
        range 1 3600
        default 60
        help
            Time between automatic mouse movements after the first movement.

    config MOUSE_MOVE_DISTANCE
        int "Movement distance per step"
        range 1 50
        default 3
        help
            Relative X/Y movement in each side of the square pattern.

endmenu
```

## sdkconfig.defaults
```kconfig
# ESP32-C3 / 4 MB flash
CONFIG_IDF_TARGET="esp32c3"
CONFIG_ESPTOOLPY_FLASHSIZE_4MB=y

# BLE-only HID device using NimBLE
CONFIG_BT_ENABLED=y
CONFIG_BT_NIMBLE_ENABLED=y
CONFIG_BT_NIMBLE_HID_SERVICE=y
CONFIG_BT_NIMBLE_MAX_CONNECTIONS=1

# Leave enough room for the Bluetooth stack.
CONFIG_PARTITION_TABLE_SINGLE_APP_LARGE=y
```
